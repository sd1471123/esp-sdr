## main/Kconfig.projbuild
```kconfig
menu "ESP-SDR transport"

    config ESP_SDR_UART_ENABLED
        bool "Burst UART0 I/Q transport" if !IDF_TARGET_ESP32 && !IDF_TARGET_ESP32C2
        depends on IDF_TARGET_ESP32H2 || IDF_TARGET_ESP32C2 || IDF_TARGET_ESP32C5 || IDF_TARGET_ESP32C3 || IDF_TARGET_ESP32 || IDF_TARGET_ESP32S2 || IDF_TARGET_ESP32S3 || IDF_TARGET_ESP32C61 || IDF_TARGET_ESP32C6 || IDF_TARGET_ESP32S31
        default y
        help
            Enable the optional USB-to-UART bridge interface. Disable it to
            leave the UART GPIOs unused by the application. Native USB remains
            available on chips that support it. The original ESP32 and ESP32-C2 require UART.

    config ESP_SDR_UART_BAUD
        int "Burst UART0 I/Q baud rate"
        depends on IDF_TARGET_ESP32H2 || IDF_TARGET_ESP32C2 || IDF_TARGET_ESP32C5 || IDF_TARGET_ESP32C3 || IDF_TARGET_ESP32 || IDF_TARGET_ESP32S2 || IDF_TARGET_ESP32S3 || IDF_TARGET_ESP32C61 || IDF_TARGET_ESP32C6 || IDF_TARGET_ESP32S31
        range 115200 2500000 if IDF_TARGET_ESP32C2
        range 115200 3000000 if !IDF_TARGET_ESP32C2
        default 2000000
        help
            The burst I/Q protocol is also available on UART0, 8N1, without
            hardware flow control. The browser baud rate must match this value.
            BAUD 1000000 and BAUD 2000000 can change the running UART rate.
            Resetting the board restores this configured default.

    config ESP_SDR_UART_TX_PIN
        int "Burst UART0 TX GPIO"
        depends on IDF_TARGET_ESP32H2 || IDF_TARGET_ESP32C2 || IDF_TARGET_ESP32C5 || IDF_TARGET_ESP32C3 || IDF_TARGET_ESP32 || IDF_TARGET_ESP32S2 || IDF_TARGET_ESP32S3 || IDF_TARGET_ESP32C61 || IDF_TARGET_ESP32C6 || IDF_TARGET_ESP32S31
        range 0 20 if IDF_TARGET_ESP32C2
        range 0 27 if IDF_TARGET_ESP32H2
        range 0 48 if !IDF_TARGET_ESP32S31 && !IDF_TARGET_ESP32C2 && !IDF_TARGET_ESP32H2
        range 0 63 if IDF_TARGET_ESP32S31
        default 1 if IDF_TARGET_ESP32
        default 24 if IDF_TARGET_ESP32H2
        default 20 if IDF_TARGET_ESP32C2
        default 21 if IDF_TARGET_ESP32C3
        default 58 if IDF_TARGET_ESP32S31
        default 16 if IDF_TARGET_ESP32C6
        default 11 if IDF_TARGET_ESP32C61 || IDF_TARGET_ESP32C5
        default 43

    config ESP_SDR_UART_RX_PIN
        int "Burst UART0 RX GPIO"
        depends on IDF_TARGET_ESP32H2 || IDF_TARGET_ESP32C2 || IDF_TARGET_ESP32C5 || IDF_TARGET_ESP32C3 || IDF_TARGET_ESP32 || IDF_TARGET_ESP32S2 || IDF_TARGET_ESP32S3 || IDF_TARGET_ESP32C61 || IDF_TARGET_ESP32C6 || IDF_TARGET_ESP32S31
        range 0 20 if IDF_TARGET_ESP32C2
        range 0 27 if IDF_TARGET_ESP32H2
        range 0 48 if !IDF_TARGET_ESP32S31 && !IDF_TARGET_ESP32C2 && !IDF_TARGET_ESP32H2
        range 0 63 if IDF_TARGET_ESP32S31
        default 3 if IDF_TARGET_ESP32
        default 23 if IDF_TARGET_ESP32H2
        default 19 if IDF_TARGET_ESP32C2
        default 20 if IDF_TARGET_ESP32C3
        default 59 if IDF_TARGET_ESP32S31
        default 17 if IDF_TARGET_ESP32C6
        default 10 if IDF_TARGET_ESP32C61
        default 12 if IDF_TARGET_ESP32C5
        default 44

    config ESP_SDR_LED_PIN
        int "Status RGB LED GPIO (-1 disables)"
        range -1 48 if !IDF_TARGET_ESP32S31 && !IDF_TARGET_ESP32C2
        range -1 20 if IDF_TARGET_ESP32C2
        range -1 63 if IDF_TARGET_ESP32S31
        default 27 if IDF_TARGET_ESP32C5
        default -1
        help
            GPIO wired to the on-board addressable (WS2812 class) RGB LED, driven
            with an RMT channel because the protocol lives in the pulse widths.
            The pin is then removed from the GPIO command's pool. -1 disables the
            LED support; the ESP32-C5-DevKitC-1 puts its RGB LED on GPIO27.

endmenu
```
